## Kconfig
```kconfig
config PROSPECTOR_LAYER_ROLLER_ALL_CAPS
    bool "Convert layer names to all caps"
    default n

config PROSPECTOR_ROTATE_DISPLAY_180
    bool "Rotate the display 180 degrees"
    default n

config PROSPECTOR_USE_AMBIENT_LIGHT_SENSOR
    bool "Use ambient light sensor for auto brightness"
    default y

config PROSPECTOR_FIXED_BRIGHTNESS
    int "Fixed display brightness"
    default 50
    range 1 100
    depends on !PROSPECTOR_USE_AMBIENT_LIGHT_SENSOR
config PROSPECTOR_PERIPHERAL_CHARGING_SERVICE
    bool "Tell the Prospector dongle when this keyboard half is on USB power"
    depends on ZMK_SPLIT && !ZMK_SPLIT_ROLE_CENTRAL && ZMK_BLE && USB_DEVICE_STACK
    help
      Set on the keyboard halves. Adds a small GATT service the dongle reads
      to show a charging bolt instead of the battery percentage, which reads
      about 100% while charging.

config PROSPECTOR_CHARGING_INDICATOR
    bool "Show a charging bolt for keyboard halves on USB power"
    default y
    depends on SHIELD_PROSPECTOR_ADAPTER && ZMK_SPLIT_ROLE_CENTRAL && ZMK_SPLIT_BLE
    help
      Needs PROSPECTOR_PERIPHERAL_CHARGING_SERVICE on the halves; halves
      without it just show their percentage.

config PROSPECTOR_WPM_PANEL
    bool "Show a words-per-minute panel (number + history graph)"
    default y
    depends on ZMK_WPM
    select LV_USE_CHART

config PROSPECTOR_ACTIVE_LAYER_Y
    int "Vertical offset of the active layer name from the screen center"
    default -62 if PROSPECTOR_WPM_PANEL
    default -20
    help
      Read-only layout value for code that places its own objects level with
      the active layer (e.g. extra indicators added from a user config).

config PROSPECTOR_ZAPPY_BIRDS
    bool "Zappy Birds: hidden tap-to-fly game on the dongle screen"
    default n
    depends on SHIELD_PROSPECTOR_ADAPTER
    select LV_USE_LABEL
    select LV_USE_LINE
    select LV_USE_FLEX
    help
      Adds the &zappy (toggle game mode) and &zflap (flap) behaviors and the
      game screen. Pair with a keymap layer of &zflap bindings.

config PROSPECTOR_TYPING_PET
    bool "Typing pet: a pet that grows with your typing, in place of the WPM panel"
    default n
    depends on SHIELD_PROSPECTOR_ADAPTER && PROSPECTOR_WPM_PANEL && ZMK_WPM
    select LV_USE_LABEL
    select LV_USE_BAR
    select LV_USE_IMG
    select LV_USE_CANVAS
    help
      Adds the &pet (swap the WPM panel and the pet, feed, mini-game) and
      &petkey (mini-game guess) behaviors. Pair &petkey with a keymap layer
      named "Pet" for the mini-game.

config PROSPECTOR_ROLLER_HIDDEN_LAYER_NAME
    string "Display names of keymap layers to leave out of the layer roller"
    default "Zappy,Pet" if PROSPECTOR_ZAPPY_BIRDS && PROSPECTOR_TYPING_PET
    default "Zappy" if PROSPECTOR_ZAPPY_BIRDS
    default "Pet" if PROSPECTOR_TYPING_PET
    default ""
    help
      Comma-separated, e.g. "Zappy,Pet". Matched by whole name, so it keeps
      working when ZMK Studio reorders layers.

config PROSPECTOR_MATRIX_SCREENSAVER
    bool "Matrix rain screensaver (half-width katakana) on the dongle screen"
    default n
    depends on SHIELD_PROSPECTOR_ADAPTER

config PROSPECTOR_MATRIX_TIMEOUT_S
    int "Seconds without a key press before the screensaver starts"
    range 30 3600
    default 120
    depends on PROSPECTOR_MATRIX_SCREENSAVER
    help
      In seconds. Must be at least CONFIG_ZMK_IDLE_TIMEOUT, which is in
      milliseconds (30000, i.e. 30 s, by default): the countdown starts
      when ZMK reports idle.
```
